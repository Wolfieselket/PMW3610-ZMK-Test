## Kconfig.defconfig
```kconfig
if SHIELD_NICEVIEW_TEST

config ZMK_KEYBOARD_NAME
    default "NiceView Test"

endif
```

## config/west.yml
```yaml
manifest:
  remotes:
    - name: zmkfirmware
      url-base: https://github.com/zmkfirmware
    - name: my-pmw-driver
      url-base: https://github.com/Wolfieselket

  projects:
    - name: zmk
      remote: zmkfirmware
      revision: main
      import: app/west.yml

    - name: zmk-pmw3610-driver
      remote: my-pmw-driver
      revision: main

  self:
    path: config
```
