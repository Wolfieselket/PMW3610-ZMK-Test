
#include <zephyr/dt-bindings/gpio/gpio.h>

/ {
    pmw3610_spi: pmw3610_spi {
        compatible = "zephyr,spi-bitbang";
        status = "okay";

        clk-gpios = <&gpio0 22 GPIO_ACTIVE_HIGH>;
        mosi-gpios = <&gpio0 8 GPIO_ACTIVE_HIGH>;
        miso-gpios = <&gpio0 8 GPIO_ACTIVE_HIGH>;
        cs-gpios = <&gpio0 2 GPIO_ACTIVE_LOW>;

        #address-cells = <1>;
        #size-cells = <0>;

        pmw3610: pmw3610@0 {
            compatible = "pixart,pmw3610-alt";
            reg = <0>;
            spi-max-frequency = <2000000>;
            irq-gpios = <&gpio1 15 GPIO_ACTIVE_LOW>;
            status = "okay";
        };
    };
};
